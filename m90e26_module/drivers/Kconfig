## m90e26_module/drivers/Kconfig
```kconfig
# drivers/sensor/Kconfig

# Copyright (c) 2022 Nordic Semiconductor ASA
# SPDX-License-Identifier: Apache-2.0
menu "Drivers"
rsource "sensor/Kconfig"
endmenu
```

## m90e26_module/drivers/sensor/Kconfig
```kconfig
# drivers/sensor/m90e26/Kconfig
if SENSOR
rsource "m90e26/Kconfig"
endif # SENSOR
```

## m90e26_module/drivers/sensor/m90e26/Kconfig
```kconfig
config M90E26
    bool "Atmel M90E26 energy metering IC"
    default n
    depends on DT_HAS_ATMEL_M90E26_ENABLED
    select CONFIG_UART_ASYNC_API# 啟用 UART 驅動
    help
      Enable driver for the Atmel M90E26 energy metering IC using UART.

config M90E26_EMUL
    bool "Enable Atmel M90E26 Emulator Driver"
    default y
    depends on EMUL
    help
      Enable the software emulator for the Atmel M90E26 energy
      metering IC. This is intended for host-based testing without
      actual hardware.
```

## m90e26_module/dts/bindings/sensor/atmel,m90e26-emul.yaml
```yaml
description: Atmel M90E26 Energy Metering IC Emulator

compatible: "atmel,m90e26-emul"

properties:
  label:
    type: string
    description: Human readable name for the emulator instance.
```

## m90e26_module/dts/bindings/sensor/atmel,m90e26.yaml
```yaml
# dts/bindings/sensor/atmel,m90e26.yaml

description: Atmel M90E26 Single-Phase Energy Metering IC (UART)

compatible: "atmel,m90e26"

# 引入 base.yaml 以包含 'label' 等標準屬性
include: base.yaml
```

## tests/m90e26_driver/testcase.yaml
```yaml
tests:
  testing.driver.m90e26:
    # 標記這個測試需要在 native_sim 平台上執行
    platform_allow: native_sim
    # 標記為單元測試
    tags: test drivers sensor
    # 整合類型：僅編譯和執行
    integration_platforms:
      - native_sim

west build -b native_sim/native/64 --no-sysbuild -d ./build --pristine -- -DZEPHYR_EXTRA_MODULES=/home/randy/Documents/nordic_project/m90e26_driver_example/m90e26_module -DCONF_FILE="./prj.conf" -DDTC_OVERLAY_FILE="./boards/native_sim.overlay" ./ && ./build/zephyr/zephyr.exe
```
